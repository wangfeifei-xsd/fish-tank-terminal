## main/Kconfig.projbuild
```kconfig
menu "Fish Tank Terminal"

    config FISH_TANK_TERMINAL
        bool "Enable Fish Tank Terminal application"
        default y

    config FISH_MOCK_API
        bool "Use mock API responses (offline development)"
        default y
        help
            Return built-in JSON when HTTP gateway is unavailable.

    config FISH_AUTO_POLL
        bool "Auto poll tank/temperature every 60 seconds"
        default y

    config FISH_API_HOST
        string "Device API host URL"
        default "https://api.marinefish.fun"

    config FISH_APP_KEY
        string "Default AppKey (override via NVS)"
        default "ak_hardware_dev_01"

    config FISH_APP_SECRET
        string "Default AppSecret (override via NVS)"
        default "dK9mN2xQ7vL4pR8tW3jF5hB1cZ6yA0uE"

    config FISH_DEV_WIFI_SSID
        string "Dev WiFi SSID (skip BLE provision when set)"
        default ""
        help
            For lab bring-up when C6/BLE is unavailable. If non-empty, credentials
            are written to NVS on boot and the device skips BLE provisioning.

    config FISH_DEV_WIFI_PASS
        string "Dev WiFi password"
        default ""

    config FISH_LOGICAL_WIDTH
        int "Logical canvas width (landscape)"
        default 1024
        help
            Must match the physical panel width in landscape mode
            (7" EK79007: 1024, 5" WKS50HD071: 1280).

    config FISH_LOGICAL_HEIGHT
        int "Logical canvas height (landscape)"
        default 600
        help
            Must match the physical panel height in landscape mode
            (7" EK79007: 600, 5" WKS50HD071: 720).

endmenu
```

## sdkconfig.defaults
```kconfig
CONFIG_IDF_TARGET="esp32p4"
CONFIG_ESP_DEFAULT_CPU_FREQ_MHZ=400
CONFIG_ESPTOOLPY_FLASHSIZE_16MB=y
CONFIG_ESPTOOLPY_FLASHSIZE="16MB"
CONFIG_SPIRAM=y
CONFIG_SPIRAM_MODE_HEX=y
CONFIG_SPIRAM_SPEED_200M=y
# CONFIG_LV_COLOR_16_SWAP is not set
CONFIG_LV_FONT_MONTSERRAT_24=y
CONFIG_LV_MEM_SIZE_KILOBYTES=96
CONFIG_LV_FONT_FMT_TXT_LARGE=y
CONFIG_FISH_TANK_TERMINAL=y
# CONFIG_FISH_MOCK_API is not set
CONFIG_FISH_AUTO_POLL=y
# 7" EK79007 MIPI (1024x600 landscape). Use 1280x720 for 5" WKS50HD071.
CONFIG_FISH_LOGICAL_WIDTH=1024
CONFIG_FISH_LOGICAL_HEIGHT=600
CONFIG_LV_USE_PNG=y
CONFIG_LV_USE_FS_STDIO=y
CONFIG_LV_FS_STDIO_LETTER=83
CONFIG_LV_FS_STDIO_PATH="/spiffs"
CONFIG_LV_IMG_CACHE_DEF_SIZE=16
CONFIG_PARTITION_TABLE_CUSTOM=y
CONFIG_PARTITION_TABLE_CUSTOM_FILENAME="partitions.csv"
CONFIG_BT_ENABLED=y
CONFIG_BT_NIMBLE_ENABLED=y
CONFIG_BT_CONTROLLER_DISABLED=y
CONFIG_ESP_HOSTED_ENABLED=y
CONFIG_ESP_HOSTED_CP_TARGET_ESP32C6=y
CONFIG_ESP_HOSTED_ENABLE_BT_NIMBLE=y
CONFIG_ESP_ENABLE_BT_NIMBLE=y
CONFIG_BT_NIMBLE_TRANSPORT_UART=n
CONFIG_ESP_HOSTED_SDIO_HOST_INTERFACE=y
CONFIG_ESP_HOSTED_SDIO_SLOT_1=y
CONFIG_ESP_HOSTED_SDIO_4_BIT_BUS=y
CONFIG_ESP_HOSTED_SDIO_PIN_CMD=53
CONFIG_ESP_HOSTED_SDIO_PIN_CLK=54
CONFIG_ESP_HOSTED_SDIO_PIN_D0=49
CONFIG_ESP_HOSTED_SDIO_PIN_D1=50
CONFIG_ESP_HOSTED_SDIO_PIN_D2=51
CONFIG_ESP_HOSTED_SDIO_PIN_D3=52
CONFIG_ESP_HOSTED_PRIV_SDIO_PIN_CMD_SLOT_1=53
CONFIG_ESP_HOSTED_PRIV_SDIO_PIN_CLK_SLOT_1=54
CONFIG_ESP_HOSTED_PRIV_SDIO_PIN_D0_SLOT_1=49
CONFIG_ESP_HOSTED_PRIV_SDIO_PIN_D1_4BIT_BUS_SLOT_1=50
CONFIG_ESP_HOSTED_PRIV_SDIO_PIN_D2_4BIT_BUS_SLOT_1=51
CONFIG_ESP_HOSTED_PRIV_SDIO_PIN_D3_4BIT_BUS_SLOT_1=52
CONFIG_ESP_HOSTED_SDIO_GPIO_RESET_SLAVE=19
CONFIG_ESP_HOSTED_GPIO_SLAVE_RESET_SLAVE=19
CONFIG_ESP_HOSTED_SDIO_RESET_ACTIVE_HIGH=y
CONFIG_ESP_HOSTED_SLAVE_RESET_ON_EVERY_HOST_BOOTUP=y

# TLS: prefer PSRAM — internal RAM is too tight after LVGL/anim preload
# CONFIG_MBEDTLS_INTERNAL_MEM_ALLOC is not set
CONFIG_MBEDTLS_EXTERNAL_MEM_ALLOC=y
CONFIG_MBEDTLS_DYNAMIC_BUFFER=y
# 8192 truncates larger TLS records from /tank/detail (~13KB JSON) → read -0x0087
CONFIG_MBEDTLS_SSL_IN_CONTENT_LEN=16384
CONFIG_MBEDTLS_SSL_OUT_CONTENT_LEN=4096
# CONFIG_MBEDTLS_CERTIFICATE_BUNDLE_DEFAULT_CMN is not set
CONFIG_MBEDTLS_CERTIFICATE_BUNDLE_DEFAULT_FULL=y
CONFIG_SPIRAM_MALLOC_RESERVE_INTERNAL=98304
```
